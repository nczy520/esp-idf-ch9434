## Kconfig
```kconfig
menu "CH9434 配置"

    config CH9434_SPI_HOST
        int "SPI 主机外设编号"
        default 2
        range 0 3
        help
            用于与 CH9434 通信的 SPI 外设。
            ESP32-S3 上可用 SPI2_HOST (2) 和 SPI3_HOST (3)。
            SPI0/1 预留给 flash/PSRAM，不可使用。

    config CH9434_PIN_MOSI
        int "MOSI GPIO 引脚"
        default 11
        range 0 48
        help
            连接到 CH9434 MOSI（主出从入）的 GPIO 引脚。

    config CH9434_PIN_MISO
        int "MISO GPIO 引脚"
        default 13
        range 0 48
        help
            连接到 CH9434 MISO（主入从出）的 GPIO 引脚。

    config CH9434_PIN_SCK
        int "SCK GPIO 引脚"
        default 12
        range 0 48
        help
            连接到 CH9434 SCK（SPI 时钟）的 GPIO 引脚。

    config CH9434_PIN_CS
        int "CS GPIO 引脚"
        default 10
        range 0 48
        help
            连接到 CH9434 CS（片选，低电平有效）的 GPIO 引脚。

    config CH9434_SPI_CLOCK_HZ
        int "SPI 时钟频率（Hz）"
        default 200000
        range 50000 1000000
        help
            SPI 时钟频率，单位 Hz。CH9434 数据手册列出 16 MHz 为绝对最大值，
            但在 ESP32-S3 上 MISO 时序在约 250 kHz 以上就不可靠。
            200 kHz 是安全默认值。

    config CH9434_SPI_QUEUE_SIZE
        int "SPI 请求队列深度"
        default 16
        range 4 64
        help
            服务任务可容纳的待处理 SPI 请求数量。
            每个请求约 40 字节。如果有大量任务并发进行 UART IO，
            请增大此值。

    config CH9434_SPI_TASK_STACK
        int "SPI 服务任务栈大小（字节）"
        default 3072
        range 2048 8192
        help
            专用 SPI 服务任务的栈大小。

    config CH9434_SPI_TASK_PRIO
        int "SPI 服务任务优先级"
        default 10
        range 1 24
        help
            SPI 服务任务的优先级。应高于任何调用 CH9434 API 的任务，
            以最小化 SPI 延迟。

    config CH9434_TX_CHUNK_SIZE
        int "UART TX 分块大小"
        default 128
        range 16 256
        help
            每次 TX FIFO 写入的字节数。CH9434A 的 TX FIFO 为 1536 字节；
            分块可以保持单次 SPI 事务简短，让 FIFO 在两次写入之间排空。
endmenu
```

## esp_ch9434/Kconfig
```kconfig
menu "CH9434 配置"

    config CH9434_SPI_HOST
        int "SPI 主机外设编号"
        default 2
        range 0 3
        help
            用于与 CH9434 通信的 SPI 外设。
            ESP32-S3 上可用 SPI2_HOST (2) 和 SPI3_HOST (3)。
            SPI0/1 预留给 flash/PSRAM，不可使用。

    config CH9434_PIN_MOSI
        int "MOSI GPIO 引脚"
        default 11
        range 0 48
        help
            连接到 CH9434 MOSI（主出从入）的 GPIO 引脚。

    config CH9434_PIN_MISO
        int "MISO GPIO 引脚"
        default 13
        range 0 48
        help
            连接到 CH9434 MISO（主入从出）的 GPIO 引脚。

    config CH9434_PIN_SCK
        int "SCK GPIO 引脚"
        default 12
        range 0 48
        help
            连接到 CH9434 SCK（SPI 时钟）的 GPIO 引脚。

    config CH9434_PIN_CS
        int "CS GPIO 引脚"
        default 10
        range 0 48
        help
            连接到 CH9434 CS（片选，低电平有效）的 GPIO 引脚。

    config CH9434_SPI_CLOCK_HZ
        int "SPI 时钟频率（Hz）"
        default 2000000
        range 50000 16000000
        help
            SPI 时钟频率，单位 Hz。CH9434 数据手册标称最大支持 16 MHz。
            为保证通信稳定性，默认采用 2 MHz。
            实际可用最高频率受硬件布线、电源稳定性及 MCU SPI 外设限制。

    config CH9434_SPI_QUEUE_SIZE
        int "SPI 请求队列深度"
        default 16
        range 4 64
        help
            服务任务可容纳的待处理 SPI 请求数量。
            每个请求约 40 字节。如果有大量任务并发进行 UART IO，
            请增大此值。

    config CH9434_SPI_TASK_STACK
        int "SPI 服务任务栈大小（字节）"
        default 3072
        range 2048 8192
        help
            专用 SPI 服务任务的栈大小。

    config CH9434_SPI_TASK_PRIO
        int "SPI 服务任务优先级"
        default 10
        range 1 24
        help
            SPI 服务任务的优先级。应高于任何调用 CH9434 API 的任务，
            以最小化 SPI 延迟。

    config CH9434_TX_CHUNK_SIZE
        int "UART TX 分块大小"
        default 128
        range 16 256
        help
            每次 TX FIFO 写入的字节数。CH9434A 的 TX FIFO 为 1536 字节；
            分块可以保持单次 SPI 事务简短，让 FIFO 在两次写入之间排空。

    config CH9434_TX_WAIT_MS
        int "TX FIFO 满时等待时间（毫秒）"
        default 5
        range 1 100
        help
            当 TX FIFO 空间不足时，每次重试前等待的毫秒数。
            值越小延迟越低，但 CPU 占用越高。

    config CH9434_TX_MAX_RETRIES
        int "TX 写入最大重试次数"
        default 200
        range 10 10000
        help
            TX FIFO 满时的最大重试次数。超过则返回 ESP_ERR_TIMEOUT。
            默认 200 次 * 5ms = 1 秒超时。
            设置较大值可适配极低波特率下的大数据量传输。
endmenu
```

## examples/sample_project/sdkconfig.defaults
```kconfig
# ESP32-S3 target
CONFIG_IDF_TARGET="esp32s3"

# Use USB Serial/JTAG for console output (built-in USB on ESP32-S3 dev boards)
CONFIG_ESP_CONSOLE_USB_SERIAL_JTAG=y
# Disable the legacy UART console so the on-board USB port is used
CONFIG_ESP_CONSOLE_NONE=n

# Lower log noise from boot
CONFIG_BOOTLOADER_LOG_LEVEL_WARN=y
CONFIG_LOG_DEFAULT_LEVEL_INFO=y

# ---------- CH9434 driver defaults ----------
CONFIG_CH9434_SPI_HOST=2
CONFIG_CH9434_PIN_MOSI=11
CONFIG_CH9434_PIN_MISO=13
CONFIG_CH9434_PIN_SCK=12
CONFIG_CH9434_PIN_CS=10
CONFIG_CH9434_SPI_CLOCK_HZ=200000
CONFIG_CH9434_SPI_QUEUE_SIZE=16
CONFIG_CH9434_SPI_TASK_STACK=3072
CONFIG_CH9434_SPI_TASK_PRIO=10
CONFIG_CH9434_TX_CHUNK_SIZE=128
```
